#include <Display.hpp>


const unsigned char inactive_joystick_data[] PROGMEM  = {
0x00, 0x00, 0x00, 0x00, 0x00, 0x00, 0x07, 0x80, 0x0c, 0xc0, 0x18, 0x60, 0x10, 0x20, 0x10, 0x20, 
0x18, 0x60, 0x0c, 0xc0, 0x07, 0x80, 0x00, 0x00, 0x00, 0x00, 0x00, 0x00, 0x00, 0x00
};

const unsigned char button_joystick_data[] PROGMEM  = {
0x00, 0x00, 0x00, 0x00, 0x00, 0x00, 0x07, 0x80, 0x0c, 0xc0, 0x1b, 0x60, 0x17, 0xa0, 0x17, 0xa0, 
0x1b, 0x60, 0x0c, 0xc0, 0x07, 0x80, 0x00, 0x00, 0x00, 0x00, 0x00, 0x00, 0x00, 0x00
};

const unsigned char u_joystick_data[] PROGMEM  = {
0x07, 0x80, 0x18, 0x60, 0x30, 0x30, 0x27, 0x90, 0x0c, 0xc0, 0x18, 0x60, 0x10, 0x20, 0x10, 0x20, 
0x18, 0x60, 0x0c, 0xc0, 0x07, 0x80, 0x00, 0x00, 0x00, 0x00, 0x00, 0x00, 0x00, 0x00
};

const unsigned char d_joystick_data[] PROGMEM  = {
0x00, 0x00, 0x00, 0x00, 0x00, 0x00, 0x07, 0x80, 0x0c, 0xc0, 0x18, 0x60, 0x10, 0x20, 0x10, 0x20, 
0x18, 0x60, 0x0c, 0xc0, 0x27, 0x90, 0x30, 0x30, 0x18, 0x60, 0x07, 0x80, 0x00, 0x00
};

const unsigned char l_joystick_data[] PROGMEM  = {
0x00, 0x00, 0x00, 0x00, 0x30, 0x00, 0x67, 0x80, 0x4c, 0xc0, 0x98, 0x60, 0x90, 0x20, 0x90, 0x20, 
0x98, 0x60, 0x4c, 0xc0, 0x67, 0x80, 0x30, 0x00, 0x00, 0x00, 0x00, 0x00, 0x00, 0x00
};

const unsigned char r_joystick_data[] PROGMEM  = {
0x00, 0x00, 0x00, 0x00, 0x00, 0x30, 0x07, 0x98, 0x0c, 0xc8, 0x18, 0x64, 0x10, 0x24, 0x10, 0x24, 
0x18, 0x64, 0x0c, 0xc8, 0x07, 0x98, 0x00, 0x30, 0x00, 0x00, 0x00, 0x00, 0x00, 0x00
};

const unsigned char ul_joystick_data[] PROGMEM  = {
0x1e, 0x00, 0x70, 0x00, 0x40, 0x00, 0xc7, 0x80, 0x8c, 0xc0, 0x98, 0x60, 0x90, 0x20, 0x10, 0x20, 
0x18, 0x60, 0x0c, 0xc0, 0x07, 0x80, 0x00, 0x00, 0x00, 0x00, 0x00, 0x00, 0x00, 0x00
};

const unsigned char ur_joystick_data[] PROGMEM  = {
0x01, 0xe0, 0x00, 0x38, 0x00, 0x08, 0x07, 0x8c, 0x0c, 0xc4, 0x18, 0x64, 0x10, 0x24, 0x10, 0x20, 
0x18, 0x60, 0x0c, 0xc0, 0x07, 0x80, 0x00, 0x00, 0x00, 0x00, 0x00, 0x00, 0x00, 0x00
};

const unsigned char dl_joystick_data[] PROGMEM  = {
0x00, 0x00, 0x00, 0x00, 0x00, 0x00, 0x07, 0x80, 0x0c, 0xc0, 0x18, 0x60, 0x10, 0x20, 0x90, 0x20, 
0x98, 0x60, 0x8c, 0xc0, 0xc7, 0x80, 0x40, 0x00, 0x70, 0x00, 0x1e, 0x00, 0x00, 0x00
};

const unsigned char dr_joystick_data[] PROGMEM  = {
0x00, 0x00, 0x00, 0x00, 0x00, 0x00, 0x07, 0x80, 0x0c, 0xc0, 0x18, 0x60, 0x10, 0x20, 0x10, 0x24, 
0x18, 0x64, 0x0c, 0xc4, 0x07, 0x8c, 0x00, 0x08, 0x00, 0x38, 0x01, 0xe0, 0x00, 0x00
};



Display_Interface::Display_Interface(){
    update = false;
    //loading sprites
    joystick_sprites[0] = inactive_joystick_data;
    joystick_sprites[1] = button_joystick_data;
    joystick_sprites[2] = u_joystick_data;
    joystick_sprites[3] = d_joystick_data;
    joystick_sprites[4] = l_joystick_data;
    joystick_sprites[5] = r_joystick_data;
    joystick_sprites[6] = ul_joystick_data;
    joystick_sprites[7] = ur_joystick_data;
    joystick_sprites[8] = dr_joystick_data;
    joystick_sprites[9] = dl_joystick_data;
}

int Display_Interface::setup_display(){
    Wire.begin(21,22);
    display = Adafruit_SSD1306(SCREEN_WIDTH, SCREEN_HEIGHT, &Wire, -1);
    if(!display.begin(SSD1306_SWITCHCAPVCC, 0x3C)){
        return -1;
    }
    display.clearDisplay();
    display.setTextSize(1);
    display.setCursor(0,0);
    display.setTextColor(SSD1306_WHITE);
    display.println("Screen online.");
    display.display();

    return 0;
}

void Display_Interface::update_display(u_int32_t signal_latency, uint32_t loop_latency, u_int32_t *packet_loss){
    display.clearDisplay();
    display.setCursor(2, 0);
    display.print("SGNL: ");
    if(signal_latency<5){
        display.print("]]])");
    }else if(signal_latency<15){
        display.print("]]] ");
    }else if(signal_latency<30){
        display.print("]]- ");
    }else if(signal_latency<60){
        display.print("]-- ");
    }else{
        display.print("LOST ");
    }

    display.print("| LP: ");

    display.print(loop_latency);
    display.println(" ms");

    if(*packet_loss>1){
        display.println("    PACKET LOSS!");
        *packet_loss -= 1;
    }

    display.setCursor(0, 25);
    display.print("J1: ");
    display.drawBitmap(28, 22, joystick_sprites[stateToIndex[activity.j1]], 15, 15, SSD1306_WHITE);
    
    display.print("         J2: ");
    display.drawBitmap(105, 22, joystick_sprites[stateToIndex[activity.j2]], 15, 15, SSD1306_WHITE);

    display.setCursor(0, 40);
    display.print("P1:");
    if(activity.p1 < 10){
        display.print(" ");
    }if (activity.p1 < 100){
        display.print(" ");
    }
    display.print(activity.p1);
    display.print("%      P2:");
    if(activity.p2 < 10){
        display.print(" ");
    }if (activity.p2 < 100){
        display.print(" ");
    }
    display.print(activity.p2);
    display.println("%");


    display.setCursor(0, 55);
    display.print("S1: ");
    if(activity.s1){
        display.print("ON ");
    }else{
        display.print("OFF");
    }
    display.print("      S2: ");
    if(activity.s2){
        display.print("ON ");
    }else{
        display.print("OFF");
    }

    display.display();
}